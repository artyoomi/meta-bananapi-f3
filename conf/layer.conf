## conf/layer.conf
```bitbake
# We have a conf and classes directory, add to BBPATH
BBPATH =. "${LAYERDIR}:"

# We have recipes-* directories, add to BBFILES
BBFILES += "${LAYERDIR}/recipes-*/*/*.bb \
            ${LAYERDIR}/recipes-*/*/*.bbappend"

BBFILE_COLLECTIONS += "meta-bananapi-f3"
BBFILE_PATTERN_meta-bananapi-f3 := "^${LAYERDIR}/"
BBFILE_PRIORITY_meta-bananapi-f3 = "5"

LAYERSERIES_COMPAT_meta-bananapi-f3 = "styhead scarthgap"
LAYERDEPENDS_meta-bananapi-f3 = "core"
```

## conf/machine/bananapi-f3.conf
```bitbake
#@TYPE: Machine
#@NAME: bananapi-f3
#@SOC: Banana Pi F3
#@DESCRIPTION: Machine configuration for the Banana Pi F3 development board

DEFAULTTUNE ?= "bananapi-f3-series"
require conf/machine/include/riscv/tune-bananapi-f3.inc

UBOOT_MACHINE = "k1_defconfig"

UBOOT_DTB = "1"
#UBOOT_DTB_BINARY="FSBL.bin"
# SPL_BINARY = "spl/u-boot-spl.bin"

KERNEL_IMAGETYPE = "Image.itb"
IMAGE_FSTYPES += "cpio.gz ext2"
KERNEL_DEVICETREE = "spacemit/k1-x_deb1.dtb"
SERIAL_CONSOLES = "115200;ttyS0"
PREFERRED_PROVIDER_virtual/bootloader ?= "u-boot-bananapi-f3"
PREFERRED_PROVIDER_virtual/kernel ?= "linux-bananapi-f3"

FILESINC += "${LAYERDIR}/files/"
```

## conf/machine/include/riscv/tune-bananapi-f3.inc
```bitbake
require conf/machine/include/riscv/tune-riscv.inc

TUNEVALID[bananapi-f3-series] = "BananaPi F3 Cores"

AVAILTUNES += " bananapi-f3-series"

# BananaPi F3 Series Cores
TUNE_FEATURES:tune-bananapi-f3-series = "${TUNE_FEATURES:tune-riscv64} bananapi-f3-series"
TUNE_ARCH:tune-bananapi-f3-series = "riscv64"
TUNE_PKGARCH:tune-bananapi-f3-series = "riscv64"
PACKAGE_EXTRA_ARCHS:tune-bananapi-f3-series = "riscv64"

# TODO: Need this?
#TUNE_CCARGS:append = "${@bb.utils.contains('TUNE_FEATURES', 'bananapi-f3-series', ' -mtune=bananapi-f3-series', ' ', d)}"
```
